/ {
    chosen {
        zmk,kscan = &kscan0;
    };

    kscan0: kscan_0 {
        compatible = "zmk,kscan-gpio-direct";
        label = "KSCAN";

        input-gpios
			= <&gpio0 22 (GPIO_PULL_UP | GPIO_ACTIVE_LOW)>
            , <&gpio0 24 (GPIO_PULL_UP | GPIO_ACTIVE_LOW)>
			;
    };
};